## boards/others/board.yml
```yaml
board:
  name: promicro
  full_name: Pro Micro
  vendor: others
  socs:
  - name: nrf52840
```

## boards/others/promicro_nrf52840_defconfig
```kconfig
# Enable MPU
CONFIG_ARM_MPU=y

# Enable hardware stack protection
CONFIG_HW_STACK_PROTECTION=y

# Enable GPIO
CONFIG_GPIO=y

# Allow device pin configuration
CONFIG_PINCTRL=y
```

## west.yml
```yaml
manifest:
  self:
    west-commands: scripts/west-commands.yml

  remotes:
    - name: zephyrproject-rtos
      url-base: https://github.com/zephyrproject-rtos
    - name: ncs
      url-base: https://github.com/nrfconnect

  projects:
    - name: nrf
      remote: ncs
      repo-path: sdk-nrf
      revision: v3.1.1
      import: true
```
